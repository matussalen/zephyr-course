## app/boards/my_board/board.yml
```yaml
board:
  name: my_board
  full_name: My Board From Scratch
  vendor: matudev
  socs:
    - name: stm32f767xx
```

## app/boards/our_board/Kconfig.defconfig
```kconfig
# STM32F767ZI Nucleo board configuration

# Copyright (c) 2019 Roland Ma
# SPDX-License-Identifier: Apache-2.0

if BOARD_OUR_BOARD

configdefault NET_L2_ETHERNET
	default y

endif # BOARD_OUR_BOARD
```

## app/boards/our_board/board.yml
```yaml
board:
  name: our_board
  full_name: Our Board
  vendor: matudev
  socs:
    - name: stm32f767xx
```

## app/custom_drivers/drivers/sensor/led_sensor/Kconfig
```kconfig
config LED_SENSOR
    bool "LED used as a sensor"
    default y
    depends on SENSOR
    depends on DT_HAS_CUSTOM_LED_SENSOR_ENABLED
    select GPIO
    help
      Enable the LED driver implementing the sensor API.
```

## app/custom_drivers/dts/bindings/sensor/custom,led-sensor.yaml
```yaml
description: GPIO LED exposed through the sensor API

compatible: "custom,led-sensor"

include: base.yaml

properties:
  gpios:
    type: phandle-array
    required: true
    description: GPIO controlling the LED
```
